## extra/Config.in
```kconfig
source "$BR2_EXTERNAL_MINIZED_PATH/package/murata-wifi/Config.in"
source "$BR2_EXTERNAL_MINIZED_PATH/package/zynq-boot/Config.in"
```

## extra/package/murata-wifi/Config.in
```kconfig
config BR2_PACKAGE_MURATA_WIFI
	bool "murata-wifi"
	help
	  Murata Wireless firmware, NVRAM and Bluetooth HCD patch files.

	  https://github.com/murata-wireless/cyw-fmac-fw
	  https://github.com/murata-wireless/cyw-fmac-nvram
	  https://github.com/murata-wireless/cyw-bt-patch
```

## extra/package/zynq-boot/Config.in
```kconfig
config BR2_PACKAGE_ZYNQ_BOOT
	bool "zynq-boot"
	help
	  A light second stage boot loader (SSBL) for the Zynq SoC

	  https://github.com/cambridgehackers/zynq-boot
	  
```
