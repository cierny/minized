&qspi {
        u-boot,dm-spl;
        #address-cells = <1>;
        #size-cells = <0>;
        flash0: flash@0 {
                compatible = "micron,m25p80";
                reg = <0x0>;
                #address-cells = <1>;
                #size-cells = <1>;
                spi-max-frequency = <50000000>;
                partition@0 {
                        label = "boot";
                        reg = <0x00000000 0x00ff0000>;
                };
        };
};
